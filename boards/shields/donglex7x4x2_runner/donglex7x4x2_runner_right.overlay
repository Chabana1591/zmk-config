#include "donglex7x4x2_runner.dtsi"

&default_transform {
    col-offset = <7>;
};

&kscan {
    // Runner3680 col pins (right side, reversed): B6(10), B2(16), B3(14), B1(15), F7(18), F6(19), F5(20)
    col-gpios
        = <&pro_micro 10 GPIO_ACTIVE_HIGH>
        , <&pro_micro 16 GPIO_ACTIVE_HIGH>
        , <&pro_micro 14 GPIO_ACTIVE_HIGH>
        , <&pro_micro 15 GPIO_ACTIVE_HIGH>
        , <&pro_micro 18 GPIO_ACTIVE_HIGH>
        , <&pro_micro 19 GPIO_ACTIVE_HIGH>
        , <&pro_micro 20 GPIO_ACTIVE_HIGH>
        ;
};
