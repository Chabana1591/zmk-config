// See https://zmk.dev/docs/development/hardware-integration/physical-layouts
// for how to configure this.

#include <dt-bindings/zmk/matrix_transform.h>

/ {
    // どのレイアウトを使用するかを指定する設定を追加
    chosen {
        zmk,physical-layout = &default_layout;
    };

    default_layout: default_layout {
        compatible = "zmk,physical-layout";
        display-name = "Default Layout";
        transform = <&default_transform>;
        kscan = <&kscan0>; // ログに合わせてkscan0に修正

        // Edit this to define the positions and sizes of the keys, or remove it
        // if your keyboard will not support ZMK Studio.
        // https://zmk.dev/docs/development/hardware-integration/physical-layouts#optional-keys-property
        keys  //                 x    y     w    h
            // Row 0 (Top)
            = <&key_coords 0    0   100 100> // L01
            , <&key_coords 100  0   100 100> // L02
            , <&key_coords 200  0   100 100> // L03
            , <&key_coords 300  0   100 100> // L04
            , <&key_coords 400  0   100 100> // L05
            , <&key_coords 500  0   100 100> // L06
            , <&key_coords 600  0   100 100> // L07
            , <&key_coords 800  0   100 100> // R01 (Gap of 1u)
            , <&key_coords 900  0   100 100> // R02
            , <&key_coords 1000 0   100 100> // R03
            , <&key_coords 1100 0   100 100> // R04
            , <&key_coords 1200 0   100 100> // R05
            , <&key_coords 1300 0   100 100> // R06
            , <&key_coords 1400 0   100 100> // R07

            // Row 1
            , <&key_coords 0    100 100 100> // L08
            , <&key_coords 100  100 100 100> // L09
            , <&key_coords 200  100 100 100> // L10
            , <&key_coords 300  100 100 100> // L11
            , <&key_coords 400  100 100 100> // L12
            , <&key_coords 500  100 100 100> // L13
            , <&key_coords 600  100 100 100> // L14
            , <&key_coords 800  100 100 100> // R08
            , <&key_coords 900  100 100 100> // R09
            , <&key_coords 1000 100 100 100> // R10
            , <&key_coords 1100 100 100 100> // R11
            , <&key_coords 1200 100 100 100> // R12
            , <&key_coords 1300 100 100 100> // R13
            , <&key_coords 1400 100 100 100> // R14

            // Row 2
            , <&key_coords 0    200 100 100> // L15
            , <&key_coords 100  200 100 100> // L16
            , <&key_coords 200  200 100 100> // L17
            , <&key_coords 300  200 100 100> // L18
            , <&key_coords 400  200 100 100> // L19
            , <&key_coords 500  200 100 100> // L20
            , <&key_coords 600  200 100 100> // L21
            , <&key_coords 800  200 100 100> // R15
            , <&key_coords 900  200 100 100> // R16
            , <&key_coords 1000 200 100 100> // R17
            , <&key_coords 1100 200 100 100> // R18
            , <&key_coords 1200 200 100 100> // R19
            , <&key_coords 1300 200 100 100> // R20
            , <&key_coords 1400 200 100 100> // R21

            // Row 3 (Bottom)
            , <&key_coords 0    300 100 100> // L22
            , <&key_coords 100  300 100 100> // L23
            , <&key_coords 200  300 100 100> // L24
            , <&key_coords 300  300 100 100> // L25
            , <&key_coords 400  300 100 100> // L26
            , <&key_coords 500  300 100 100> // L27
            , <&key_coords 600  300 100 100> // L28
            , <&key_coords 800  300 100 100> // R22
            , <&key_coords 900  300 100 100> // R23
            , <&key_coords 1000 300 100 100> // R24
            , <&key_coords 1100 300 100 100> // R25
            , <&key_coords 1200 300 100 100> // R26
            , <&key_coords 1300 300 100 100> // R27
            , <&key_coords 1400 300 100 100> // R28
            ;
    };
};