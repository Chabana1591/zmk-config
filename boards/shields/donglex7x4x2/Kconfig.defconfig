## boards/shields/donglex7x4x2/Kconfig.defconfig
```kconfig
if SHIELD_DONGLEX7X4X2_LEFT

config ZMK_KEYBOARD_NAME
    default "donglex7x4x2"

config ZMK_SPLIT_ROLE_CENTRAL
    default y

# 外部デバイス(5台) + 子機(右手) = 6
config BT_MAX_CONN
    default 6

config BT_MAX_PAIRED
    default 6

endif # SHIELD_DONGLEX7X4X2_LEFT

if SHIELD_DONGLEX7X4X2_LEFT || SHIELD_DONGLEX7X4X2_RIGHT

config ZMK_SPLIT
    default y

endif # SHIELD_DONGLEX7X4X2_LEFT || SHIELD_DONGLEX7X4X2_RIGHT

if SHIELD_DONGLEX7X4X2_DONGLE

config ZMK_KEYBOARD_NAME
    default "donglex7x4x2"

config ZMK_SPLIT_ROLE_CENTRAL
    default y

config ZMK_SPLIT
    default y

# Left and right halves = 2 peripherals
config ZMK_SPLIT_BLE_CENTRAL_PERIPHERALS
    default 2

# ZMK_SPLIT_BLE_CENTRAL_PERIPHERALS + desired BT profiles (5)
config BT_MAX_CONN
    default 7

# Same as BT_MAX_CONN
config BT_MAX_PAIRED
    default 7

endif # SHIELD_DONGLEX7X4X2_DONGLE
```

## boards/shields/donglex7x4x2/Kconfig.shield
```kconfig
config SHIELD_DONGLEX7X4X2_LEFT
    def_bool $(shields_list_contains,donglex7x4x2_left)

config SHIELD_DONGLEX7X4X2_RIGHT
    def_bool $(shields_list_contains,donglex7x4x2_right)

config SHIELD_DONGLEX7X4X2_DONGLE
    def_bool $(shields_list_contains,donglex7x4x2_dongle)

config SHIELD_DONGLEX7X4X2_DONGLE_3C
    def_bool $(shields_list_contains,donglex7x4x2_dongle_3c)

config SHIELD_DONGLEX7X4X2_DONGLE_3D
    def_bool $(shields_list_contains,donglex7x4x2_dongle_3d)
```

## boards/shields/donglex7x4x2_ergo42/Kconfig.defconfig
```kconfig
if SHIELD_DONGLEX7X4X2_ERGO42_LEFT

config ZMK_KEYBOARD_NAME
    default "donglex7x4x2_ergo42"

config ZMK_SPLIT_ROLE_CENTRAL
    default y

# 外部デバイス(5台) + 子機(右手) = 6
config BT_MAX_CONN
    default 6

config BT_MAX_PAIRED
    default 6

endif # SHIELD_DONGLEX7X4X2_ERGO42_LEFT

if SHIELD_DONGLEX7X4X2_ERGO42_LEFT || SHIELD_DONGLEX7X4X2_ERGO42_RIGHT

config ZMK_SPLIT
    default y

endif # SHIELD_DONGLEX7X4X2_ERGO42_LEFT || SHIELD_DONGLEX7X4X2_ERGO42_RIGHT

if SHIELD_DONGLEX7X4X2_ERGO42_DONGLE

config ZMK_KEYBOARD_NAME
    default "donglex7x4x2_ergo42"

config ZMK_SPLIT_ROLE_CENTRAL
    default y

config ZMK_SPLIT
    default y

# Left and right halves = 2 peripherals
config ZMK_SPLIT_BLE_CENTRAL_PERIPHERALS
    default 2

# ZMK_SPLIT_BLE_CENTRAL_PERIPHERALS + desired BT profiles (5)
config BT_MAX_CONN
    default 7

# Same as BT_MAX_CONN
config BT_MAX_PAIRED
    default 7

if ZMK_DISPLAY

config I2C
    default y

config SSD1306
    default y

endif # ZMK_DISPLAY

if LVGL

config LV_Z_VDB_SIZE
    default 64

config LV_DPI_DEF
    default 148

config LV_Z_BITS_PER_PIXEL
    default 1

choice LV_COLOR_DEPTH
    default LV_COLOR_DEPTH_1
endchoice

endif # LVGL

endif # SHIELD_DONGLEX7X4X2_ERGO42_DONGLE
```

## boards/shields/donglex7x4x2_ergo42/Kconfig.shield
```kconfig
config SHIELD_DONGLEX7X4X2_ERGO42_LEFT
    def_bool $(shields_list_contains,donglex7x4x2_ergo42_left)

config SHIELD_DONGLEX7X4X2_ERGO42_RIGHT
    def_bool $(shields_list_contains,donglex7x4x2_ergo42_right)

config SHIELD_DONGLEX7X4X2_ERGO42_DONGLE
    def_bool $(shields_list_contains,donglex7x4x2_ergo42_dongle)

config SHIELD_DONGLEX7X4X2_ERGO42_DONGLE_3C
    def_bool $(shields_list_contains,donglex7x4x2_ergo42_dongle_3c)

config SHIELD_DONGLEX7X4X2_ERGO42_DONGLE_3D
    def_bool $(shields_list_contains,donglex7x4x2_ergo42_dongle_3d)
```

## boards/shields/donglex7x4x2_runner/Kconfig.defconfig
```kconfig
if SHIELD_DONGLEX7X4X2_RUNNER_LEFT

config ZMK_KEYBOARD_NAME
    default "donglex7x4x2_runner"

config ZMK_SPLIT_ROLE_CENTRAL
    default y

endif # SHIELD_DONGLEX7X4X2_RUNNER_LEFT

if SHIELD_DONGLEX7X4X2_RUNNER_LEFT || SHIELD_DONGLEX7X4X2_RUNNER_RIGHT

config ZMK_SPLIT
    default y

endif # SHIELD_DONGLEX7X4X2_RUNNER_LEFT || SHIELD_DONGLEX7X4X2_RUNNER_RIGHT
```

## boards/shields/donglex7x4x2_runner/Kconfig.shield
```kconfig
config SHIELD_DONGLEX7X4X2_RUNNER_LEFT
    def_bool $(shields_list_contains,donglex7x4x2_runner_left)

config SHIELD_DONGLEX7X4X2_RUNNER_RIGHT
    def_bool $(shields_list_contains,donglex7x4x2_runner_right)

config SHIELD_DONGLEX7X4X2_RUNNER_DONGLE
    def_bool $(shields_list_contains,donglex7x4x2_runner_dongle)

config SHIELD_DONGLEX7X4X2_RUNNER_DONGLE_3C
    def_bool $(shields_list_contains,donglex7x4x2_runner_dongle_3c)

config SHIELD_DONGLEX7X4X2_RUNNER_DONGLE_3D
    def_bool $(shields_list_contains,donglex7x4x2_runner_dongle_3d)
```

## config/west.yml
```yaml
manifest:
  defaults:
    revision: main
  remotes:
    - name: zmkfirmware
      url-base: https://github.com/zmkfirmware
    - name: kot149
      url-base: https://github.com/kot149
    - name: englmaxi
      url-base: https://github.com/englmaxi
    # Additional modules containing boards/shields/custom code can be listed here as well
    # See https://docs.zephyrproject.org/3.2.0/develop/west/manifest.html#projects
  projects:
    - name: zmk
      remote: zmkfirmware
      import: app/west.yml
    - name: zmk-layout-shift
      remote: kot149
      revision: v1
    - name: zmk-dongle-display
      remote: englmaxi
      revision: main
  self:
    path: config
```
